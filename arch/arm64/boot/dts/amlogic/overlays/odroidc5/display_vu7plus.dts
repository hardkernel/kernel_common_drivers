/dts-v1/;
/plugin/;

#include "display_1024x600.dtsi"

/ {
	fragment@1 {
		target = <&timing0>;

		__overlay__ {
			width_mm = <153>;
			height_mm = <86>;
		};
	};

	fragment@2 {
		target = <&amhdmitx>;

		__overlay__ {
			force_hpd;
			voutmode = "dvi";
		};
	};
};
