/dts-v1/;
/plugin/;

/ {
	fragment@0 {
		target = <&drm_subsystem>;

		__overlay__ {
			display-timings {
				native-mode = <&timing0>;

				fixed-display;

				timing0: 1024x600 {
					clock-frequency = <63500000>;
					hactive = <1024>;
					vactive = <600>;
					hfront-porch = <48>;
					hsync-len = <96>;
					hback-porch = <144>;
					vfront-porch = <3>;
					vsync-len = <10>;
					vback-porch = <11>;
					hsync-active = <0>;
					vsync-active = <1>;
				};
			};
		};
	};
};
