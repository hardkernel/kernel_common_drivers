/dts-v1/;
/plugin/;

/ {
	fragment@0 {
		target = <&i2c1>;
		__overlay__ {
			status = "okay";
			#address-cells = <1>;
			#size-cells = <0>;
			clock-frequency = <100000>;		/* default 100k */

			pcf8563: rtc@51 {
				status = "okay";
				compatible = "nxp,pcf8563";
				reg = <0x51>;
				#clock-cells = <0>;
			};
		};
	};
};