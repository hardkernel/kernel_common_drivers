## drivers/amfc/Kconfig
```kconfig
config AMLOGIC_AMFC
	tristate "Amlogic AMFC driver"
	default n
	help
		Amlogic AMFC driver for
		Hardware compress/decompress module
		This module can help for speed up
		zram and some other cases which using compress/decompress

source "$(COMMON_DRIVERS_DIR)/drivers/amfc/aml_erofs/Kconfig"
```

## drivers/media/video_processor/dpss_process/Kconfig
```kconfig
# SPDX-License-Identifier: (GPL-2.0+ OR MIT)

#
# Amlogic dpss_process device configuration
#

menu "Amlogic dpss_process support"

config AMLOGIC_DPSS_PROCESS
	tristate "Amlogic dpss_process device support"
	default n

	help
		Select to enable "Amlogic dpss_process device support.

endmenu
```

## drivers/media/vout/hdmitx/Kconfig
```kconfig
# SPDX-License-Identifier: (GPL-2.0+ OR MIT)

#
# HDMITX
#
menu "Amlogic HDMITX Common Module"

config AMLOGIC_HDMITX_COMMON
	bool "AMLOGIC HDMITX common"
	default n
	help
	This option is used to configure Amlogic drivers
        of the hdmi tx common software part

source "$(COMMON_DRIVERS_DIR)/drivers/media/vout/hdmitx/hw21/Kconfig"
source "$(COMMON_DRIVERS_DIR)/drivers/media/vout/hdmitx/hw20/Kconfig"

endmenu
```

## drivers/memory_debug/memory_ext/Kconfig
```kconfig
# SPDX-License-Identifier: (GPL-2.0+ OR MIT)

config AMLOGIC_FILE_CACHE
	bool "Amlogic file cache"
	depends on AMLOGIC_MEMORY_EXTEND
	default n
	help
	  Memory debug which statisticint filecache information.
	  Enable if doubt.

config AMLOGIC_WATCHPOINT
	bool "Amlogic point driver"
	depends on AMLOGIC_MEMORY_EXTEND
	depends on HAVE_HW_BREAKPOINT
	default n
	help
	  This driver export a debug sysfs in order
	  to using watch point function on ARMv8.
	  say y to enable Amlogic watch point driver

config AMLOGIC_FAKE_SMMU
	tristate "Amlogic fake smmu"
	depends on IOMMU_SUPPORT
	default n
	help
		Register a fake smmu device to replace ops for 64bit
```

## drivers/mtd/spinor/Kconfig
```kconfig
# SPDX-License-Identifier: (GPL-2.0+ OR MIT)

config AMLOGIC_MTD_SPI_NOR
        tristate "AMLOGIC SPI NOR support"
        default n
        help
          This is based on MTD_SPI_NOR, adding partition management.
          Say Y, Will register partitions according to bootargs or dts management.
          Say N, Only register one mtd device.
```

## sound/soc/Kconfig
```kconfig
# SPDX-License-Identifier: (GPL-2.0+ OR MIT)

if SND_SOC
source "$(COMMON_DRIVERS_DIR)/sound/soc/codecs/Kconfig"
source "$(COMMON_DRIVERS_DIR)/sound/soc/amlogic/Kconfig"
endif   # SND_SOC
```
